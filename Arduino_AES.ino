#define A 10
#define B 11
#define C 12
#define D 13
#define E 14
#define F 15
#define N 4
int sboxrow(int n)
{
    int row;
    int check = n % int(pow(16,1));
  if(int(check)==0)
  {
  return int(n / pow(16,1));
  }
  return int(n / pow(16,1));
}
int sboxcol(int a)
{
  int col;
  int check = a % int(pow(16,1));
  if(int(check)==0)
  {
  col=0;
    return col;
  }
  col = a - int(a / pow(16,1))*16;
  return col;
}
const char * Elookup[16][16] = {
    {"01", "03", "05", "0F", "11", "33", "55", "FF", "1A", "2E", "72", "96", "A1", "F8", "13", "35"},
    {"5F", "E1", "38", "48", "D8", "73", "95", "A4", "F7", "02", "06", "0A", "1E", "22", "66", "AA"},
    {"E5", "34", "5C", "E4", "37", "59", "EB", "26", "6A", "BE", "D9", "70", "90", "AB", "E6", "31"},
    {"53", "F5", "04", "0C", "14", "3C", "44", "CC", "4F", "D1", "68", "B8", "D3", "6E", "B2", "CD"},
    {"4C", "D4", "67", "A9", "E0", "3B", "4D", "D7", "62", "A6", "F1", "08", "18", "28", "78", "88"},
    {"83", "9E", "B9", "D0", "6B", "BD", "DC", "7F", "81", "98", "B3", "CE", "49", "DB", "76", "9A"},
    {"B5", "C4", "57", "F9", "10", "30", "50", "F0", "0B", "1D", "27", "69", "BB", "D6", "61", "A3"},
    {"FE", "19", "2B", "7D", "87", "92", "AD", "EC", "2F", "71", "93", "AE", "E9", "20", "60", "A0"},
    {"FB", "16", "3A", "4E", "D2", "6D", "B7", "C2", "5D", "E7", "32", "56", "FA", "15", "3F", "41"},
    {"C3", "5E", "E2", "3D", "47", "C9", "40", "C0", "5B", "ED", "2C", "74", "9C", "BF", "DA", "75"},
    {"9F", "BA", "D5", "64", "AC", "EF", "2A", "7E", "82", "9D", "BC", "DF", "7A", "8E", "89", "80"},
    {"9B", "B6", "C1", "58", "E8", "23", "65", "AF", "EA", "25", "6F", "B1", "C8", "43", "C5", "54"},
    {"FC", "1F", "21", "63", "A5", "F4", "07", "09", "1B", "2D", "77", "99", "B0", "CB", "46", "CA"},
    {"45", "CF", "4A", "DE", "79", "8B", "86", "91", "A8", "E3", "3E", "42", "C6", "51", "F3", "0E"},
    {"12", "36", "5A", "EE", "29", "7B", "8D", "8C", "8F", "8A", "85", "94", "A7", "F2", "0D", "17"},
    {"39", "4B", "DD", "7C", "84", "97", "A2", "FD", "1C", "24", "6C", "B4", "C7", "52", "F6", "01"}
};
const char * Llookup[16][16] = {
    {"00", "00", "19", "01", "32", "02", "1A", "C6", "4B", "C7", "1B", "68", "33", "EE", "DF", "03"},
    {"64", "04", "E0", "0E", "34", "8D", "81", "EF", "4C", "71", "08", "C8", "F8", "69", "1C", "C1"},
    {"7D", "C2", "1D", "B5", "F9", "B9", "27", "6A", "4D", "E4", "A6", "72", "9A", "C9", "09", "78"},
    {"65", "2F", "8A", "05", "21", "0F", "E1", "24", "12", "F0", "82", "45", "35", "93", "DA", "8E"},
    {"96", "8F", "DB", "BD", "36", "D0", "CE", "94", "13", "5C", "D2", "F1", "40", "46", "83", "38"},
    {"66", "DD", "FD", "30", "BF", "06", "8B", "62", "B3", "25", "E2", "98", "22", "88", "91", "10"},
    {"7E", "6E", "48", "C3", "A3", "B6", "1E", "42", "3A", "6B", "28", "54", "FA", "85", "3D", "BA"},
    {"2B", "79", "0A", "15", "9B", "9F", "5E", "CA", "4E", "D4", "AC", "E5", "F3", "73", "A7", "57"},
    {"AF", "58", "A8", "50", "F4", "EA", "D6", "74", "4F", "AE", "E9", "D5", "E7", "E6", "AD", "E8"},
    {"2C", "D7", "75", "7A", "EB", "16", "0B", "F5", "59", "CB", "5F", "B0", "9C", "A9", "51", "A0"},
    {"7F", "0C", "F6", "6F", "17", "C4", "49", "EC", "D8", "43", "1F", "2D", "A4", "76", "7B", "B7"},
    {"CC", "BB", "3E", "5A", "FB", "60", "B1", "86", "3B", "52", "A1", "6C", "AA", "55", "29", "9D"},
    {"97", "B2", "87", "90", "61", "BE", "DC", "FC", "BC", "95", "CF", "CD", "37", "3F", "5B", "D1"},
    {"53", "39", "84", "3C", "41", "A2", "6D", "47", "14", "2A", "9E", "5D", "56", "F2", "D3", "AB"},
    {"44", "11", "92", "D9", "23", "20", "2E", "89", "B4", "7C", "B8", "26", "77", "99", "E3", "A5"},
    {"67", "4A", "ED", "DE", "C5", "31", "FE", "18", "0D", "63", "8C", "80", "C0", "F7", "70", "07"}
};
const char * multiply(char * a, char * b)
{
    int sum = 0;
    for (int k = 0; k < 2; k++)
    {
        int base = 1;
        char * temp;
        if (k == 0)
        {
            temp = a;
        }
        else
        {
            temp = b;
        }
        for (int i = 1; i >= 0; i--) 
        {
                if (temp[i] >= '0' && temp[i] <= '9') {
                    sum += (int(temp[i]) - 48) * base;
                    base = base * 16;
                }
                else if (temp[i] >= 'A' && temp[i] <= 'F') {
                    sum += (int(temp[i]) - 55) * base;
                    base = base * 16;
                }
        }
    }
    if (sum > 256)
    {
        sum = sum - 256;
    }
    int row = sboxrow(sum);
    int col = sboxcol(sum);
  Serial.println(row);
    Serial.println(col);
    Serial.println(Elookup[row][col]);
    return Elookup[row][col];
}
void shiftrows(const char * arr[][4])
{
    for(int i=1;i<N;i++)
    {
        const char ** temp = arr[i];
        for(int j=0;j<i;j++)
        {
            const char * tempB = temp[0];
            for(int k=0;k<N-1;k++)
            {
                temp[k] = temp[k + 1];
            }
            temp[N-1] = tempB;
        }
    }
}
const char* Sbox[16][16] = {
    {"63", "7C", "77", "7B", "F2", "6B", "6F", "C5", "30", "01", "67", "2B", "FE", "D7", "AB", "76"},
    {"CA", "82", "C9", "7D", "FA", "59", "47", "F0", "AD", "D4", "A2", "AF", "9C", "A4", "72", "C0"},
    {"B7", "FD", "93", "26", "36", "3F", "F7", "CC", "34", "A5", "E5", "F1", "71", "D8", "31", "15"},
    {"04", "C7", "23", "C3", "18", "96", "05", "9A", "07", "12", "80", "E2", "EB", "27", "B2", "75"},
    {"09", "83", "2C", "1A", "1B", "6E", "5A", "A0", "52", "3B", "D6", "B3", "29", "E3", "2F", "84"},
    {"53", "D1", "00", "ED", "20", "FC", "B1", "5B", "6A", "CB", "BE", "39", "4A", "4C", "58", "CF"},
    {"D0", "EF", "AA", "FB", "43", "4D", "33", "85", "45", "F9", "02", "7F", "50", "3C", "9F", "A8"},
    {"51", "A3", "40", "8F", "92", "9D", "38", "F5", "BC", "B6", "DA", "21", "10", "FF", "F3", "D2"},
    {"CD", "0C", "13", "EC", "5F", "97", "44", "17", "C4", "A7", "7E", "3D", "64", "5D", "19", "73"},
    {"60", "81", "4F", "DC", "22", "2A", "90", "88", "46", "EE", "B8", "14", "DE", "5E", "0B", "DB"},
    {"E0", "32", "3A", "0A", "49", "06", "24", "5C", "C2", "D3", "AC", "62", "91", "95", "E4", "79"},
    {"E7", "C8", "37", "6D", "8D", "D5", "4E", "A9", "6C", "56", "F4", "EA", "65", "7A", "AE", "08"},
    {"BA", "78", "25", "2E", "1C", "A6", "B4", "C6", "E8", "DD", "74", "1F", "4B", "BD", "8B", "8A"},
    {"70", "3E", "B5", "66", "48", "03", "F6", "0E", "61", "35", "57", "B9", "86", "C1", "1D", "9E"},
    {"E1", "F8", "98", "11", "69", "D9", "8E", "94", "9B", "1E", "87", "E9", "CE", "55", "28", "DF"},
    {"8C", "A1", "89", "0D", "BF", "E6", "42", "68", "41", "99", "2D", "0F", "B0", "54", "BB", "16"}
};
void setup()
{
  Serial.begin(9600);
}
void loop()
{
  char input[17]="AESUSESAMATRIXZZ";
  const char* startBox[4][4];
  for (int i=0;i<4;i++)
  {
      for (int j=0;j<4;j++)
      {
          if (input[i*4 + j] != '\0')
          {
            int row = sboxrow(int(input[i*4 + j]));
            int col = sboxcol(int(input[i*4 + j]));
            startBox[j][i] = Sbox[row][col];
          }
          else
          {
              startBox[j][i] = "40";
          }
      }
  }
  for (int i=0;i<4;i++)
  {
  for(int j=0;j<4;j++)
    {
    Serial.print(startBox[i][j]);
      delay(100);
    }
    Serial.print('\n');
  }
  shiftrows(startBox);
  Serial.print('\n');
  for (int i=0;i<4;i++)
  {
  for(int j=0;j<4;j++)
    {
    Serial.print(startBox[i][j]);
      delay(100);
    }
    Serial.print('\n');
  }
  Serial.print('\n');
  char * p = "41";
  char * l = "19";
  const char * keep;
  keep = multiply(p, l);
  Serial.println(keep);
  delay(2000);
}
